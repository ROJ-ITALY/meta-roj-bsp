## conf/layer.conf
```bitbake
# We have a conf and classes directory, add to BBPATH
BBPATH .= ":${LAYERDIR}"

# We have recipes-* directories, add to BBFILES
BBFILES += "${LAYERDIR}/recipes-*/*/*.bb \
	${LAYERDIR}/recipes-*/*/*.bbappend"

BBFILE_COLLECTIONS += "roj-bsp"
BBFILE_PATTERN_roj-bsp = "^${LAYERDIR}/"
BBFILE_PRIORITY_roj-bsp = "11"
```
